## br2-external/Config.in
```kconfig
source "$BR2_EXTERNAL_C5_PANGUI_PATH/package/retropangui-initramfs/Config.in"
source "$BR2_EXTERNAL_C5_PANGUI_PATH/package/storage-mgr/Config.in"
source "$BR2_EXTERNAL_C5_PANGUI_PATH/package/mali-ddk/Config.in"
source "$BR2_EXTERNAL_C5_PANGUI_PATH/package/freeimage/Config.in"
source "$BR2_EXTERNAL_C5_PANGUI_PATH/package/retroarch/Config.in"
source "$BR2_EXTERNAL_C5_PANGUI_PATH/package/retroarch-assets/Config.in"
source "$BR2_EXTERNAL_C5_PANGUI_PATH/package/retroarch-joypad-autoconfig/Config.in"
source "$BR2_EXTERNAL_C5_PANGUI_PATH/package/noto-cjk-font/Config.in"
source "$BR2_EXTERNAL_C5_PANGUI_PATH/package/emulationstation/Config.in"
source "$BR2_EXTERNAL_C5_PANGUI_PATH/package/bundled-roms/Config.in"
source "$BR2_EXTERNAL_C5_PANGUI_PATH/package/rpui-bundlegame/Config.in"
source "$BR2_EXTERNAL_C5_PANGUI_PATH/package/bundled-bgmusic/Config.in"
# 2026-07-14: libretro-cores(16개 코어 단일 패키지)를 코어별 독립 패키지로
# 분해(todo-20260712-libretro-cores-package-split) - 코어 하나만 고쳐도
# 스탬프 삭제 시 16개 전부 재클론+재빌드되던 문제 해결.
source "$BR2_EXTERNAL_C5_PANGUI_PATH/package/libretro-core-fceumm/Config.in"
source "$BR2_EXTERNAL_C5_PANGUI_PATH/package/libretro-core-nestopia/Config.in"
source "$BR2_EXTERNAL_C5_PANGUI_PATH/package/libretro-core-snes9x/Config.in"
source "$BR2_EXTERNAL_C5_PANGUI_PATH/package/libretro-core-pcsx-rearmed/Config.in"
source "$BR2_EXTERNAL_C5_PANGUI_PATH/package/libretro-core-beetle-psx-hw/Config.in"
source "$BR2_EXTERNAL_C5_PANGUI_PATH/package/libretro-core-picodrive/Config.in"
source "$BR2_EXTERNAL_C5_PANGUI_PATH/package/libretro-core-bluemsx/Config.in"
source "$BR2_EXTERNAL_C5_PANGUI_PATH/package/libretro-core-dosbox-pure/Config.in"
source "$BR2_EXTERNAL_C5_PANGUI_PATH/package/libretro-core-scummvm/Config.in"
source "$BR2_EXTERNAL_C5_PANGUI_PATH/package/libretro-core-quasi88/Config.in"
source "$BR2_EXTERNAL_C5_PANGUI_PATH/package/libretro-core-np2kai/Config.in"
source "$BR2_EXTERNAL_C5_PANGUI_PATH/package/libretro-core-beetle-saturn/Config.in"
source "$BR2_EXTERNAL_C5_PANGUI_PATH/package/libretro-core-mupen64plus-next/Config.in"
source "$BR2_EXTERNAL_C5_PANGUI_PATH/package/libretro-core-parallel-n64/Config.in"
source "$BR2_EXTERNAL_C5_PANGUI_PATH/package/libretro-core-ppsspp/Config.in"
source "$BR2_EXTERNAL_C5_PANGUI_PATH/package/libretro-core-kronos/Config.in"
source "$BR2_EXTERNAL_C5_PANGUI_PATH/package/libretro-core-beetle-pce/Config.in"
source "$BR2_EXTERNAL_C5_PANGUI_PATH/package/libretro-core-beetle-supergrafx/Config.in"
source "$BR2_EXTERNAL_C5_PANGUI_PATH/package/libretro-core-beetle-bsnes/Config.in"
source "$BR2_EXTERNAL_C5_PANGUI_PATH/package/libretro-core-yabasanshiro/Config.in"
source "$BR2_EXTERNAL_C5_PANGUI_PATH/package/libretro-core-fbneo/Config.in"
source "$BR2_EXTERNAL_C5_PANGUI_PATH/package/kodi-pangui-texturepacker/Config.in"
source "$BR2_EXTERNAL_C5_PANGUI_PATH/package/kodi-pangui/Config.in"
source "$BR2_EXTERNAL_C5_PANGUI_PATH/package/kodi-peripheral-joystick-pangui/Config.in"
source "$BR2_EXTERNAL_C5_PANGUI_PATH/package/rpui-launcher/Config.in"
source "$BR2_EXTERNAL_C5_PANGUI_PATH/package/rpui-wifi/Config.in"
source "$BR2_EXTERNAL_C5_PANGUI_PATH/package/rpui-rtl8821cu/Config.in"
source "$BR2_EXTERNAL_C5_PANGUI_PATH/package/rpui-bt/Config.in"
source "$BR2_EXTERNAL_C5_PANGUI_PATH/package/rpui-nodejs/Config.in"
source "$BR2_EXTERNAL_C5_PANGUI_PATH/package/uim/Config.in"
source "$BR2_EXTERNAL_C5_PANGUI_PATH/package/kmscon/Config.in"
source "$BR2_EXTERNAL_C5_PANGUI_PATH/package/odroid-drm-fbset/Config.in"
source "$BR2_EXTERNAL_C5_PANGUI_PATH/package/bundled-fonts/Config.in"
# 2026-07-15: 원격 스트리밍(todo-20260709-remote-streaming.html) br2-external
# 빌드 시도 - 소프트웨어 x264 파이프라인 1차 검증용, 하드웨어 인코더 연동 없음
source "$BR2_EXTERNAL_C5_PANGUI_PATH/package/sunshine/Config.in"
```

## br2-external/package/bundled-bgmusic/Config.in
```kconfig
config BR2_PACKAGE_BUNDLED_BGMUSIC
	bool "bundled-bgmusic"
	help
	  Bundled background music (MIDI files).
	  MIDI files are copied to /share/bios/music/ on first boot.
	  Requires BR2_PACKAGE_FLUID_SOUNDFONT for playback (VLC
	  fluidsynth plugin in EmulationStation uses FluidR3_GM.sf2,
	  MIT license, installed to /usr/share/soundfonts/).
```

## br2-external/package/bundled-fonts/Config.in
```kconfig
config BR2_PACKAGE_BUNDLED_FONTS
	bool "bundled-fonts"
	help
	  번들 한글 폰트 (나눔고딕/나눔바른고딕/D2Coding/Pretendard).
	  예전엔 TTF(~24MB)를 rootfs-overlay에 직접 커밋했는데 저장소
	  용량·출처 추적성 문제로 빌드 시 다운로드 방식으로 전환
	  (2026-07-13). 빌드 전 board/odroidc5/fetch-fonts.sh 실행 필요
	  (build.sh가 자동 실행) - 공식 배포처 URL + sha256 고정.
```

## br2-external/package/bundled-roms/Config.in
```kconfig
config BR2_PACKAGE_BUNDLED_ROMS
	bool "bundled-roms"
	help
	  Freely licensed homebrew games bundled with the image.
	  Copied to /share/roms/ on first boot.
```

## br2-external/package/c5-pangui-target/Config.in
```kconfig
# c5-pangui-target/Config.in - 실제 빌드 산출물이 없는 순수 설정 심볼 모음.
# .mk 파일 없음(설치할 것이 없음) - Config.in만 존재하는 "가상 패키지" 디렉토리.
#
# 목적(todo-20260712-libretro-cores-package-split.html 후속 작업 3, 2026-07-19
# 설계 / 2026-07-21 구현): "이 코어는 이 기기/GPU에서 지원 안 됨"을 defconfig
# 수동 주석이 아니라 구조적으로 선언하기 위한 최상위 지점. 최상위에서 타겟
# 기기를 하나 고르면 그 기기의 하드웨어 특성 심볼이 select되고, 각 코어의
# Config.in이 그 특성 심볼에 depends on을 걸어서 자동으로 켜지고 꺼진다.
#
# 지금은 기기가 odroidc5 하나뿐이라 choice가 사실상 고정 선택이지만, 새 기기가
# 추가되면 여기에 config 항목만 하나 더 추가하면 되고 하부(각 코어의
# depends on) 코드는 그대로 유지된다.
#
# 적용 범위: 하드웨어 특성으로 인한 "확정적 미지원"에만 사용
# (kronos/mupen64plus-next - GPU 드라이버·컴파일러 레벨 크래시, 코어 패치
# 안 하는 방침상 회피 불가). 성능/정책적 이유로 "지금은 안 씀"인 코어
# (beetle-psx-hw/beetle-saturn/beetle-pce/beetle-supergrafx)는 여기 안 걸고
# defconfig 주석으로 그대로 유지 - "절대 못 씀"과 "지금은 안 씀"을 같은
# 메커니즘으로 섞으면 나중에 정책이 바뀔 때 구분이 안 됨(문서 참고).

choice
	prompt "RetroPangUI 타겟 기기"
	default BR2_PACKAGE_C5_PANGUI_TARGET_ODROIDC5

config BR2_PACKAGE_C5_PANGUI_TARGET_ODROIDC5
	bool "Odroid C5 (Amlogic S905X5M)"
	select BR2_PACKAGE_C5_PANGUI_GPU_MALI_VALHALL

endchoice

# 하드웨어 특성 심볼 - 코어 Config.in이 이 심볼에 depends on을 걸어서 참조.
# 프롬프트 없음(choice가 자동으로 select) - 사용자가 직접 켜고 끄는 심볼이 아님.
config BR2_PACKAGE_C5_PANGUI_GPU_MALI_VALHALL
	bool
```

## br2-external/package/emulationstation/Config.in
```kconfig
config BR2_PACKAGE_EMULATIONSTATION
	bool "emulationstation"
	depends on BR2_PACKAGE_SDL2
	depends on BR2_PACKAGE_MESA3D_OPENGL_ES
	depends on BR2_PACKAGE_FREEIMAGE
	depends on BR2_PACKAGE_VLC
	depends on BR2_PACKAGE_FREETYPE
	depends on BR2_PACKAGE_LIBCURL
	depends on BR2_PACKAGE_ALSA_LIB
	depends on BR2_PACKAGE_RAPIDJSON
	help
	  EmulationStation is a cross-platform graphical front-end
	  for emulators with controller navigation support.

	  https://github.com/LeonardWard/retropangui-emulationstation
```

## br2-external/package/freeimage/Config.in
```kconfig
config BR2_PACKAGE_FREEIMAGE
	bool "freeimage"
	help
	  FreeImage is an Open Source library project for developers
	  who would like to support popular graphics image formats.

	  https://freeimage.sourceforge.net/
```

## br2-external/package/gamepad-mgr/Config.in
```kconfig
config BR2_PACKAGE_GAMEPAD_MGR
	bool "gamepad-mgr"
	depends on BR2_PACKAGE_SDL2
	help
	  SDL2 기반 게임패드 슬롯 매니저 라이브러리.
	  Player 1~4 슬롯 관리, GUID 기반 재연결 복원,
	  GC 매핑 / raw 조이스틱 폴백을 제공한다.
```

## br2-external/package/kmscon/Config.in
```kconfig
config BR2_PACKAGE_KMSCON
	bool "kmscon"
	depends on BR2_PACKAGE_HAS_UDEV
	depends on BR2_TOOLCHAIN_HAS_THREADS
	select BR2_PACKAGE_LIBDRM
	select BR2_PACKAGE_LIBXKBCOMMON
	select BR2_PACKAGE_FREETYPE
	select BR2_PACKAGE_FONTCONFIG
	select BR2_PACKAGE_ZLIB
	help
	  DRM/KMS 기반 가상 콘솔 - fbterm이 이 기기(DRM_FBDEV_EMULATION)에서
	  화면 전환이 안 되는 문제(2026-07-08 실기기에서 확인 - 배너는
	  fbcon으로 정상 출력되지만 fbterm이 그래픽 모드로 전환하면 화면이
	  검게 나옴, 프레임버퍼엔 데이터가 있는데 실제 디스플레이 컨트롤러가
	  그 버퍼를 스캔아웃하지 않는 것으로 추정)를 우회하기 위해 fbterm을
	  대체하는 용도. fbterm과 달리 libdrm을 직접 링크해서 DRM 네이티브로
	  동작하므로 이 문제 자체가 구조적으로 발생하지 않음.

	  한글 입출력은 여전히 uim-fep(byeoru)를 그대로 씀 - kmscon은 화면
	  렌더링/VT 관리만 담당하고, `kmscon --login -- uim-fep`처럼 uim-fep를
	  자식 프로세스로 실행시키는 방식으로 통합.

	  libtsm(터미널 상태 머신)은 meson subproject wrap으로 빌드 중
	  자동으로 git clone됨(네트워크 필요) - 별도 패키징 안 함.

	  https://github.com/kmscon/kmscon

comment "kmscon needs udev and a toolchain w/ threads"
	depends on !BR2_PACKAGE_HAS_UDEV || !BR2_TOOLCHAIN_HAS_THREADS
```

## br2-external/package/kodi-pangui-jsonschemabuilder/Config.in
```kconfig
config BR2_PACKAGE_KODI_PANGUI_JSONSCHEMABUILDER
	bool "kodi-pangui-jsonschemabuilder"
	help
	  Host JsonSchemaBuilder tool for kodi-pangui (21.3-Omega)
```

## br2-external/package/kodi-pangui/Config.in
```kconfig
config BR2_PACKAGE_KODI_PANGUI
	bool "kodi-pangui"
	depends on BR2_TOOLCHAIN_HAS_THREADS_NPTL
	depends on BR2_INSTALL_LIBSTDCPP
	depends on BR2_USE_WCHAR
	depends on BR2_TOOLCHAIN_GCC_AT_LEAST_8
	select BR2_PACKAGE_FFMPEG
	select BR2_PACKAGE_LIBASS
	select BR2_PACKAGE_LIBFRIBIDI
	select BR2_PACKAGE_FREETYPE
	select BR2_PACKAGE_FONTCONFIG
	select BR2_PACKAGE_SQLITE
	select BR2_PACKAGE_LIBXML2
	select BR2_PACKAGE_LIBPNG
	select BR2_PACKAGE_GIFLIB
	select BR2_PACKAGE_JPEG
	select BR2_PACKAGE_ZLIB
	select BR2_PACKAGE_OPENSSL
	select BR2_PACKAGE_LIBCURL
	select BR2_PACKAGE_PCRE
	select BR2_PACKAGE_PCRE2
	select BR2_PACKAGE_TAGLIB
	select BR2_PACKAGE_TINYXML
	select BR2_PACKAGE_TINYXML2
	select BR2_PACKAGE_FLATBUFFERS
	select BR2_PACKAGE_PYTHON3
	select BR2_PACKAGE_FSTRCMP
	select BR2_PACKAGE_LIBCDIO
	select BR2_PACKAGE_LIBCROSSGUID
	select BR2_PACKAGE_LIBDISPLAY_INFO
	select BR2_PACKAGE_LIBDRM
	select BR2_PACKAGE_LIBUDFREAD
	select BR2_PACKAGE_LIBINPUT
	select BR2_PACKAGE_LIBXKBCOMMON
	select BR2_PACKAGE_ALSA_LIB
	select BR2_PACKAGE_EUDEV
	select BR2_PACKAGE_LZO
	select BR2_PACKAGE_EXPAT
	help
	  Kodi Media Center (GBM/KMS platform, GLES2, Mali DDK)
	  https://kodi.tv
```

## br2-external/package/kodi-peripheral-joystick-pangui/Config.in
```kconfig
config BR2_PACKAGE_KODI_PERIPHERAL_JOYSTICK_PANGUI
	bool "kodi-peripheral-joystick-pangui"
	depends on BR2_PACKAGE_KODI_PANGUI
	depends on BR2_PACKAGE_HAS_UDEV
	select BR2_PACKAGE_TINYXML
	help
	  Kodi joystick peripheral addon (Omega 21.x).
	  Provides joystick/gamepad support for Kodi including
	  button mapping and controller profiles.

	  https://github.com/xbmc/peripheral.joystick

comment "kodi-peripheral-joystick-pangui needs kodi-pangui and udev"
	depends on !BR2_PACKAGE_KODI_PANGUI || !BR2_PACKAGE_HAS_UDEV
```

## br2-external/package/kodi.disabled/Config.in
```kconfig
config BR2_PACKAGE_KODI
	bool "kodi"
	depends on BR2_PACKAGE_HAS_LIBGLES
	depends on BR2_PACKAGE_HAS_LIBEGL
	depends on BR2_TOOLCHAIN_HAS_THREADS_NPTL
	depends on BR2_INSTALL_LIBSTDCPP
	depends on BR2_USE_WCHAR
	depends on BR2_TOOLCHAIN_GCC_AT_LEAST_8
	select BR2_PACKAGE_FFMPEG
	select BR2_PACKAGE_LIBASS
	select BR2_PACKAGE_FRIBIDI
	select BR2_PACKAGE_FREETYPE
	select BR2_PACKAGE_FONTCONFIG
	select BR2_PACKAGE_SQLITE
	select BR2_PACKAGE_LIBXML2
	select BR2_PACKAGE_LIBPNG
	select BR2_PACKAGE_LIBJPEG
	select BR2_PACKAGE_ZLIB
	select BR2_PACKAGE_OPENSSL
	select BR2_PACKAGE_LIBCURL
	select BR2_PACKAGE_PCRE2
	select BR2_PACKAGE_TINYXML2
	select BR2_PACKAGE_FLATBUFFERS
	select BR2_PACKAGE_PYTHON3
	select BR2_PACKAGE_LIBINPUT
	select BR2_PACKAGE_LIBXKBCOMMON
	select BR2_PACKAGE_ALSA_LIB
	select BR2_PACKAGE_LIBUDEV
	select BR2_PACKAGE_LZO
	select BR2_PACKAGE_EXPAT
	help
	  Kodi Media Center (GBM/KMS platform, GLES2)
	  Latest stable: 21.2 "Omega"
	  https://kodi.tv
```

## br2-external/package/libretro-core-beetle-bsnes/Config.in
```kconfig
config BR2_PACKAGE_LIBRETRO_CORE_BEETLE_BSNES
	bool "libretro-core-beetle-bsnes"
	help
	  beetle_bsnes libretro core - SNES/Famicom (Mednafen이 이식한 구버전
	  bsnes 0.59 포크, 소프트웨어 렌더링).

	  주의(상류 공식 안내): "더 이상 쓸 이유가 없음 - Snes9x나 Supafaust가
	  더 빠르고, 이후 bsnes 포크나 Mesen-S가 더 정확함." 이 프로젝트는
	  이미 snes9x가 1순위로 있음 - 이 코어는 대체/실험용 2순위.

	  https://github.com/libretro/beetle-bsnes-libretro
```

## br2-external/package/libretro-core-beetle-pce/Config.in
```kconfig
config BR2_PACKAGE_LIBRETRO_CORE_BEETLE_PCE
	bool "libretro-core-beetle-pce"
	help
	  beetle_pce libretro core - PC Engine/TurboGrafx-16 (Mednafen 기반,
	  CD-ROM2 + SuperGrafx 지원, 소프트웨어 렌더링).

	  https://github.com/libretro/beetle-pce-libretro
```

## br2-external/package/libretro-core-beetle-psx-hw/Config.in
```kconfig
config BR2_PACKAGE_LIBRETRO_CORE_BEETLE_PSX_HW
	bool "libretro-core-beetle-psx-hw"
	help
	  beetle-psx-hw libretro core - PlayStation 1 (Vulkan HW 렌더러).

	  https://github.com/libretro/beetle-psx-libretro
```

## br2-external/package/libretro-core-beetle-saturn/Config.in
```kconfig
config BR2_PACKAGE_LIBRETRO_CORE_BEETLE_SATURN
	bool "libretro-core-beetle-saturn"
	help
	  beetle_saturn libretro core - Sega Saturn (Mednafen 기반, 소프트웨어 렌더링).

	  https://github.com/libretro/beetle-saturn-libretro
```

## br2-external/package/libretro-core-beetle-supergrafx/Config.in
```kconfig
config BR2_PACKAGE_LIBRETRO_CORE_BEETLE_SUPERGRAFX
	bool "libretro-core-beetle-supergrafx"
	help
	  beetle_supergrafx libretro core - PC Engine SuperGrafx 전용
	  (Mednafen 기반, 소프트웨어 렌더링).

	  https://github.com/libretro/beetle-supergrafx-libretro
```

## br2-external/package/libretro-core-bluemsx/Config.in
```kconfig
config BR2_PACKAGE_LIBRETRO_CORE_BLUEMSX
	bool "libretro-core-bluemsx"
	help
	  blueMSX libretro core - MSX / MSX2 / MSX2+ / MSX turbo R.

	  https://github.com/libretro/bluemsx-libretro
```

## br2-external/package/libretro-core-dosbox-pure/Config.in
```kconfig
config BR2_PACKAGE_LIBRETRO_CORE_DOSBOX_PURE
	bool "libretro-core-dosbox-pure"
	help
	  dosbox-pure libretro core - DOS.

	  https://github.com/schellingb/dosbox-pure
```

## br2-external/package/libretro-core-fbneo/Config.in
```kconfig
config BR2_PACKAGE_LIBRETRO_CORE_FBNEO
	bool "libretro-core-fbneo"
	help
	  FBNeo (FinalBurn Neo) libretro core - CPS1/CPS2/CPS3, Neo Geo,
	  Neo Geo CD 등 아케이드 시스템.

	  https://github.com/libretro/FBNeo
```

## br2-external/package/libretro-core-fceumm/Config.in
```kconfig
config BR2_PACKAGE_LIBRETRO_CORE_FCEUMM
	bool "libretro-core-fceumm"
	help
	  fceumm libretro core - NES/Famicom/FDS (BIOS 불필요, FDS 내장
	  에뮬레이션 지원).

	  https://github.com/libretro/libretro-fceumm
```

## br2-external/package/libretro-core-kronos/Config.in
```kconfig
config BR2_PACKAGE_LIBRETRO_CORE_KRONOS
	bool "libretro-core-kronos"
	depends on !BR2_PACKAGE_C5_PANGUI_GPU_MALI_VALHALL
	help
	  kronos libretro core - Sega Saturn (GL 가속, beetle_saturn과 별개 코어).

	  https://github.com/libretro/yabause

	  Mali-G310(Valhall) GPU에서 GLSL ES 스펙 위반("Global variable
	  initializer must be a constant expression")으로 컴파일러가 VDP2 블릿
	  셰이더를 거부, abort() 100% 재현(2026-07-19 실측) - 코어 소스는
	  패치하지 않는 방침이라 이 GPU 계열 기기에서는 자동으로 비활성화됨.
```

## br2-external/package/libretro-core-mame2003-plus/Config.in
```kconfig
config BR2_PACKAGE_LIBRETRO_CORE_MAME2003_PLUS
	bool "libretro-core-mame2003-plus"
	help
	  MAME 2003-Plus libretro core - 구형(2003년 MAME 기준) 아케이드
	  롬셋 호환. FBNeo가 지원하지 않는 구형/저사양 아케이드 게임용.

	  https://github.com/libretro/mame2003-plus-libretro
```
