## br2-external/package/libretro-core-mame2010/Config.in
```kconfig
config BR2_PACKAGE_LIBRETRO_CORE_MAME2010
	bool "libretro-core-mame2010"
	help
	  MAME 2010(0.139 기준) libretro core - fbneo/mame2003-plus보다
	  더 오래된 아케이드 롬셋 호환용.

	  https://github.com/libretro/mame2010-libretro
```

## br2-external/package/libretro-core-mame2016/Config.in
```kconfig
config BR2_PACKAGE_LIBRETRO_CORE_MAME2016
	bool "libretro-core-mame2016"
	help
	  MAME 2016(0.174 기준) libretro core. genie/premake 기반 대형
	  빌드 시스템이라 다른 아케이드 코어보다 빌드 실패 가능성이 높음 -
	  실패 시 defconfig에서 비활성화하고 원인을 todo-core 문서에 기록.

	  https://github.com/libretro/mame2016-libretro
```

## br2-external/package/libretro-core-mupen64plus-next/Config.in
```kconfig
config BR2_PACKAGE_LIBRETRO_CORE_MUPEN64PLUS_NEXT
	bool "libretro-core-mupen64plus-next"
	depends on !BR2_PACKAGE_C5_PANGUI_GPU_MALI_VALHALL
	help
	  mupen64plus-next libretro core - Nintendo 64.

	  https://github.com/libretro/mupen64plus-libretro-nx

	  모든 CPU/RDP 렌더러 조합에서 100% 크래시(2026-07-19 실측) - 원인은
	  GLideN64의 glMapBufferRange() NULL 미체크(Mali-G310 드라이버가 매핑
	  실패). 코어 소스는 패치하지 않는 방침이라 이 GPU 계열 기기에서는
	  자동으로 비활성화됨. n64는 parallel-n64가 1순위 대안.
```

## br2-external/package/libretro-core-nestopia/Config.in
```kconfig
config BR2_PACKAGE_LIBRETRO_CORE_NESTOPIA
	bool "libretro-core-nestopia"
	help
	  nestopia libretro core - NES/Famicom.

	  https://github.com/libretro/nestopia
```

## br2-external/package/libretro-core-np2kai/Config.in
```kconfig
config BR2_PACKAGE_LIBRETRO_CORE_NP2KAI
	bool "libretro-core-np2kai"
	help
	  np2kai libretro core - NEC PC-9801.

	  https://github.com/libretro/np2kai
```

## br2-external/package/libretro-core-parallel-n64/Config.in
```kconfig
config BR2_PACKAGE_LIBRETRO_CORE_PARALLEL_N64
	bool "libretro-core-parallel-n64"
	help
	  parallel-n64 libretro core - Nintendo 64 (대체 코어, GLideN64 렌더러).

	  https://github.com/libretro/parallel-n64
```

## br2-external/package/libretro-core-pcsx-rearmed/Config.in
```kconfig
config BR2_PACKAGE_LIBRETRO_CORE_PCSX_REARMED
	bool "libretro-core-pcsx-rearmed"
	help
	  pcsx_rearmed libretro core - PlayStation 1.

	  https://github.com/libretro/pcsx_rearmed
```

## br2-external/package/libretro-core-picodrive/Config.in
```kconfig
config BR2_PACKAGE_LIBRETRO_CORE_PICODRIVE
	bool "libretro-core-picodrive"
	help
	  picodrive libretro core - Sega Mega Drive / Genesis / 32X / Mega-CD.

	  https://github.com/libretro/picodrive
```

## br2-external/package/libretro-core-ppsspp/Config.in
```kconfig
config BR2_PACKAGE_LIBRETRO_CORE_PPSSPP
	bool "libretro-core-ppsspp"
	help
	  ppsspp libretro core - PlayStation Portable.

	  https://github.com/hrydgard/ppsspp
```

## br2-external/package/libretro-core-quasi88/Config.in
```kconfig
config BR2_PACKAGE_LIBRETRO_CORE_QUASI88
	bool "libretro-core-quasi88"
	help
	  quasi88 libretro core - NEC PC-8801.

	  https://github.com/libretro/quasi88-libretro
```

## br2-external/package/libretro-core-scummvm/Config.in
```kconfig
config BR2_PACKAGE_LIBRETRO_CORE_SCUMMVM
	bool "libretro-core-scummvm"
	help
	  scummvm libretro core - Point-and-click adventures.

	  https://github.com/libretro/scummvm
```

## br2-external/package/libretro-core-snes9x/Config.in
```kconfig
config BR2_PACKAGE_LIBRETRO_CORE_SNES9X
	bool "libretro-core-snes9x"
	help
	  snes9x libretro core - SNES/Super Famicom.

	  https://github.com/libretro/snes9x
```

## br2-external/package/libretro-core-yabasanshiro/Config.in
```kconfig
config BR2_PACKAGE_LIBRETRO_CORE_YABASANSHIRO
	bool "libretro-core-yabasanshiro"
	help
	  yabasanshiro libretro core - Sega Saturn (Yabause 계열, OpenGL/GLES
	  가속, beetle_saturn보다 낮은 정확도 대신 빠른 속도·내부 해상도 업스케일).

	  주의(상류 공식 안내): "outdated, 이슈 많음, unmaintained - 가능하면
	  다른 새턴 코어 권장." 이 프로젝트는 이미 beetle_saturn(1순위)·
	  kronos(2순위)가 있음 - 이 코어는 실험용 3순위.

	  https://github.com/libretro/yabause (브랜치: yabasanshiro)
```

## br2-external/package/libretro-cores/Config.in
```kconfig
config BR2_PACKAGE_LIBRETRO_CORES
	bool "libretro-cores"
	help
	  Libretro cores for RetroArch: fceumm/nestopia (NES), snes9x (SNES),
	  pcsx_rearmed/beetle_psx_hw (PSX), picodrive (MD/32X/MCD), bluemsx (MSX),
	  dosbox_pure (DOS), scummvm, quasi88 (PC-88), np2kai (PC-98),
	  beetle_saturn (Saturn), mupen64plus_next/parallel_n64 (N64), ppsspp (PSP).
```

## br2-external/package/mali-ddk/Config.in
```kconfig
config BR2_PACKAGE_MALI_DDK
	bool "mali-ddk"
	help
	  ARM Mali-G310 Valhall DDK r44p0 (proprietary binary driver).
	  libMali.so provides EGL, OpenGL ES, GBM, Wayland-EGL, OpenCL, Vulkan.

	  Requires blobs to be pre-populated via board/odroidc5/fetch-blobs.sh.
	  See board/odroidc5/blobs/README.md for instructions.
```

## br2-external/package/noto-cjk-font/Config.in
```kconfig
config BR2_PACKAGE_NOTO_CJK_FONT
	bool "noto-cjk-font"
	help
	  Noto Sans CJK(Regular, 한중일 통합 OTC) 폰트 - ES의 폴백 폰트
	  목록(es-core/src/resources/Font.cpp)이 이미 참조하고 있던
	  /usr/share/fonts/opentype/noto/NotoSansCJK-Regular.ttc 경로를
	  실제로 채워서, 일본어/중국어 한자 게임 제목이 빈 네모로 깨지지
	  않도록 함. Pretendard(기본 UI 폰트)엔 한자 글리프가 없음.

	  https://github.com/notofonts/noto-cjk
```

## br2-external/package/odroid-drm-fbset/Config.in
```kconfig
config BR2_PACKAGE_ODROID_DRM_FBSET
	bool "odroid-drm-fbset"
	select BR2_PACKAGE_LIBDRM
	help
	  HDMI 출력 모드 설정 도구. Hardkernel 공식 Ubuntu 이미지에서
	  추출해 쓰던 동명 바이너리(블랙박스)를 자체 구현으로 교체한 것.
	  DRM atomic commit으로 모드 설정 + fbcon 프레임버퍼를 플레인에
	  바인딩해 화면 출력까지 활성화한다.

	  원본과의 차이(버그 수정):
	  - 실패 시 non-zero exit code (원본은 항상 0)
	  - -showmodes가 순수 조회 전용 (원본은 첫 모드로 커밋하는 부작용)
	  - 없는 모드 요청 시 에러 (원본은 조용히 첫 모드로 폴백)
```

## br2-external/package/retroarch-assets/Config.in
```kconfig
config BR2_PACKAGE_RETROARCH_ASSETS
	bool "retroarch-assets"
	help
	  RetroArch Ozone/XMB 메뉴에 필요한 UI 텍스처·아이콘 패키지.
	  retroarch 빌드의 media/ 에는 폰트만 포함되므로 별도로 설치해야 함.

	  https://github.com/libretro/retroarch-assets
```

## br2-external/package/retroarch-joypad-autoconfig/Config.in
```kconfig
config BR2_PACKAGE_RETROARCH_JOYPAD_AUTOCONFIG
	bool "retroarch-joypad-autoconfig"
	help
	  RetroArch 공식 커뮤니티 컨트롤러 autoconfig DB(udev 서브셋).
	  이 프로젝트가 실기기에서 직접 검증·수정한 장치(핫키 select 통일,
	  X/Y 순서 수정 등)는 board/odroidc5/rootfs-overlay/etc/retroarch/
	  autoconfig/에 그대로 유지되고, 이 패키지는 그 장치명과 겹치지
	  않는 나머지만 설치함.

	  https://github.com/libretro/retroarch-joypad-autoconfig
```

## br2-external/package/retroarch/Config.in
```kconfig
config BR2_PACKAGE_RETROARCH
	bool "retroarch"
	depends on BR2_PACKAGE_SDL2
	depends on BR2_PACKAGE_MESA3D_OPENGL_ES
	depends on BR2_PACKAGE_LIBDRM
	help
	  RetroArch is the reference frontend for the libretro API.

	  https://www.retroarch.com/
```

## br2-external/package/retropangui-initramfs/Config.in
```kconfig
config BR2_PACKAGE_RETROPANGUI_INITRAMFS
	bool "retropangui-initramfs"
	help
	  Builds a minimal busybox static binary and packages it with the
	  initramfs init script as a uInitrd image. The initramfs mounts
	  the squashfs root, overlayfs, and performs OTA update handling
	  before switch_root.
```

## br2-external/package/rpui-bt/Config.in
```kconfig
config BR2_PACKAGE_RPUI_BT
	bool "rpui-bt"
	select BR2_PACKAGE_BLUEZ5_UTILS
	select BR2_PACKAGE_BLUEZ5_UTILS_CLIENT
	select BR2_PACKAGE_LIBGLIB2
	help
	  RetroPangUI 블루투스 관리 데몬.
	  USB BT 동글 핫플러그 감지, /var/lib/bluetooth를 share 파티션으로
	  영속화, BlueZ D-Bus API(GDBus)에 직접 붙어 에이전트 등록·어댑터
	  제어·페어링(InterfacesAdded/PropertiesChanged 이벤트 기반)을
	  담당한다. list/live_devices/remove는 bluetoothctl 조회를 그대로 씀.
```

## br2-external/package/rpui-bundlegame/Config.in
```kconfig
config BR2_PACKAGE_RPUI_BUNDLEGAME
	bool "rpui-bundlegame"
	help
	  Bundle ROM management command.
	  Manages symlinks from bundled-roms image path to share/roms/,
	  and controls visibility via gamelist.xml hidden flag.
```

## br2-external/package/rpui-launcher/Config.in
```kconfig
config BR2_PACKAGE_RPUI_LAUNCHER
	bool "rpui-launcher"
	default y
	depends on BR2_PACKAGE_PYTHON3
	help
	  RetroPangUI game launcher script.
	  Installs /usr/bin/rpui-launcher which is invoked by
	  EmulationStation to launch RetroArch with the correct core
	  and appendconfig chain.
```

## br2-external/package/rpui-nodejs/Config.in
```kconfig
config BR2_PACKAGE_RPUI_NODEJS
	bool "rpui-nodejs"
	depends on BR2_aarch64
	depends on BR2_TOOLCHAIN_USES_GLIBC
	help
	  AI CLI(Claude Code, Gemini CLI, Codex CLI 등)를 실기기에서
	  npm install -g로 설치·실행할 수 있게 nodejs.org 공식 사전
	  컴파일 바이너리(linux-arm64)를 그대로 설치한다.

	  Buildroot 자체 nodejs 패키지는 V8을 처음부터 컴파일하고
	  버전이 오래 고정돼 있어(2026-07 기준 20.11.1), Claude Code
	  같은 최신 CLI가 요구하는 Node 22+를 못 맞춤 — 공식 배포
	  tarball을 그대로 받아 쓰는 쪽이 버전도 최신이고 빌드 시간도
	  훨씬 짧음.

	  https://nodejs.org/
```
