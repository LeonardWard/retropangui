## br2-external/package/rpui-rtl8821cu/Config.in
```kconfig
comment "rpui-rtl8821cu needs a Linux kernel to be built"
	depends on !BR2_LINUX_KERNEL

config BR2_PACKAGE_RPUI_RTL8821CU
	bool "rpui-rtl8821cu"
	depends on BR2_LINUX_KERNEL
	help
	  RTL8821CU WiFi 커널 드라이버 (하드커널 WiFi Module 5B/5BK 등).
	  Buildroot 기본 rtl8821cu 패키지(morrownr/8821cu-20210916)가
	  cfg80211 API 변경으로 커널 5.15+에서 빌드 실패해서, ODROID
	  포럼이 하드커널 기기용으로 추천하는 brektrou/rtl8821CU 소스로
	  대체한 버전.

	  https://github.com/brektrou/rtl8821CU
```

## br2-external/package/rpui-wifi/Config.in
```kconfig
config BR2_PACKAGE_RPUI_WIFI
	bool "rpui-wifi"
	select BR2_PACKAGE_WPA_SUPPLICANT
	select BR2_PACKAGE_WPA_SUPPLICANT_CLI
	help
	  RetroPangUI WiFi 관리 데몬.
	  USB WiFi 동글 핫플러그 감지, wpa_supplicant/udhcpc 제어,
	  ES와 파일 기반 IPC(status.json)를 담당한다.
```

## br2-external/package/storage-mgr/Config.in
```kconfig
config BR2_PACKAGE_STORAGE_MGR
	bool "storage-mgr"
	help
	  RetroPangUI 저장장치 관리 데몬.
	  외부 저장장치(USB/SD) 핫플러그 감지, ES와 파일 기반 IPC,
	  share 파티션 선택 및 boot.conf 업데이트를 담당한다.
```

## br2-external/package/sunshine/Config.in
```kconfig
config BR2_PACKAGE_SUNSHINE
	bool "sunshine"
	depends on BR2_PACKAGE_LIBDRM
	depends on BR2_TOOLCHAIN_HAS_THREADS
	select BR2_PACKAGE_LIBMINIUPNPC
	select BR2_PACKAGE_OPUS
	select BR2_PACKAGE_LIBEVDEV
	select BR2_PACKAGE_NUMACTL
	select BR2_PACKAGE_JSON_FOR_MODERN_CPP
	help
	  Sunshine is a self-hosted game stream host for Moonlight,
	  built with DRM/KMS-only capture (no X11/Wayland/VAAPI/Vulkan/
	  CUDA/tray - odroidc5 minimal build). Software x264 encoding
	  only in this configuration (no hardware encoder integration -
	  that is tracked separately).

	  https://github.com/LizardByte/Sunshine
```

## br2-external/package/uim/Config.in
```kconfig
config BR2_PACKAGE_UIM
	bool "uim"
	depends on BR2_INSTALL_LIBSTDCPP
	depends on BR2_USE_WCHAR
	depends on BR2_USE_MMU # fork()
	select BR2_PACKAGE_NCURSES
	select BR2_PACKAGE_GETTEXT
	help
	  uim은 다국어 입력기 프레임워크. GTK/Qt 등 GUI 프론트엔드와
	  일본어/중국어 등 다른 언어 엔진은 전부 끄고, 순수 텍스트
	  터미널 전용 프론트엔드인 uim-fep와 한글 입력 엔진(벼루,
	  byeoru)만 활성화 - 유틸리티 터미널에서 fbterm과 함께 한글
	  입출력을 지원하기 위한 용도(2026-07-06, todo-20260706-terminal-cjk
	  핸드오버 문서 참고).

	  https://github.com/uim/uim

comment "uim needs a toolchain w/ C++, wchar, dynamic library"
	depends on BR2_USE_MMU
	depends on !BR2_INSTALL_LIBSTDCPP || !BR2_USE_WCHAR
```

## configs/odroidc5_retro_defconfig
```kconfig
# Odroid C5 Retro Gaming OS Configuration
# Target: Amlogic S905X4 (ARM Cortex-A55)

# 타겟 아키텍처
BR2_aarch64=y
BR2_cortex_a55=y
# S905X5M (Cortex-A55 기반 S7D 계열)
BR2_ARM_FPU_NEON_FP_ARMV8=y

# 시스템 설정
BR2_SYSTEM_DHCP="eth0"
BR2_TARGET_GENERIC_HOSTNAME="retropangui-c5"
BR2_TARGET_GENERIC_ISSUE="RETROPANGUI-C5 Retro Gaming OS"
BR2_ROOTFS_DEVICE_CREATION_DYNAMIC_EUDEV=y

# 타임존 (zoneinfo 설치 + 기본값 Asia/Seoul)
BR2_TARGET_TZ_INFO=y
BR2_TARGET_LOCALTIME="Asia/Seoul"

# 툴체인
BR2_TOOLCHAIN_BUILDROOT_CXX=y
BR2_TOOLCHAIN_BUILDROOT_GLIBC=y
BR2_TOOLCHAIN_BUILDROOT_LOCALE=y
BR2_TOOLCHAIN_BUILDROOT_WCHAR=y
BR2_GENERATE_LOCALE="en_US.UTF-8"
BR2_KERNEL_HEADERS_5_15=y

# U-Boot (Hardkernel 공식 브랜치)
BR2_TARGET_UBOOT=y
BR2_TARGET_UBOOT_BUILD_SYSTEM_SIMPLE=y
BR2_TARGET_UBOOT_CUSTOM_GIT=y
BR2_TARGET_UBOOT_CUSTOM_REPO_URL="https://git.odroid.com/yocto/uboot"
BR2_TARGET_UBOOT_CUSTOM_REPO_VERSION="odroidc5-v2023.01"
BR2_TARGET_UBOOT_BOARD_DEFCONFIG="s7d_odroidc5"
BR2_TARGET_UBOOT_BOARDNAME="s7d_odroidc5"
BR2_TARGET_UBOOT_NEEDS_DTC=y
# BR2_TARGET_UBOOT_FORMAT_BIN is not set
BR2_TARGET_UBOOT_FORMAT_CUSTOM=y
BR2_TARGET_UBOOT_FORMAT_CUSTOM_NAME="build/u-boot.bin"

# Linux Kernel (Hardkernel 공식 브랜치 — git 전체 히스토리 불필요, tarball로 다운로드)
BR2_LINUX_KERNEL=y
BR2_LINUX_KERNEL_CUSTOM_TARBALL=y
BR2_LINUX_KERNEL_CUSTOM_TARBALL_LOCATION="https://github.com/hardkernel/linux/archive/refs/heads/odroids7d-5.15.y.tar.gz"
BR2_LINUX_KERNEL_DEFCONFIG="odroidc5"
BR2_LINUX_KERNEL_NEEDS_HOST_OPENSSL=y
BR2_LINUX_KERNEL_INSTALL_TARGET=y
BR2_LINUX_KERNEL_PATCH="board/odroidc5/patches/linux"
BR2_LINUX_KERNEL_CONFIG_FRAGMENT_FILES="board/odroidc5/linux-ksmbd.config"

# Device Tree
BR2_LINUX_KERNEL_DTS_SUPPORT=y
BR2_LINUX_KERNEL_INTREE_DTS_NAME="amlogic/s7d_s905x5m_odroidc5"

# 파일시스템
BR2_TARGET_ROOTFS_EXT2=y
BR2_TARGET_ROOTFS_EXT2_4=y
BR2_TARGET_ROOTFS_EXT2_SIZE="8192M"
# BR2_TARGET_ROOTFS_TAR is not set

# 네트워크 패키지
BR2_PACKAGE_BUSYBOX_SHOW_OTHERS=y
BR2_PACKAGE_DROPBEAR=y
BR2_PACKAGE_WGET=y
BR2_PACKAGE_WIRELESS_TOOLS=y

# br2-external 패치 디렉토리 (SDL2 Mali Valhall 색상 수정, RetroArch DRM 수정 포함)
BR2_GLOBAL_PATCH_DIR="$(BR2_EXTERNAL_C5_PANGUI_PATH)/patches"

# Mali DDK (전용 바이너리 — scripts/fetch-blobs.sh 선행 실행 필요)
BR2_PACKAGE_MALI_DDK=y

# 그래픽 라이브러리
BR2_PACKAGE_LIBDRM=y
BR2_PACKAGE_LIBCAP=y
# Wayland (libMali.so 런타임 의존성 - Mali DDK 바이너리가 wayland-client/server를 직접 요구)
BR2_PACKAGE_WAYLAND=y

# exFAT (Share 파티션)
BR2_PACKAGE_EXFATPROGS=y
# Mesa3D - 빌드 타임 링킹용 (런타임은 libMali.so가 대체)
# Mali-G310 Valhall은 panfrost 미지원, libMali DDK 사용
BR2_PACKAGE_MESA3D=y
# panfrost는 Mali-G310 Valhall 미지원 → 크래시 원인, 제거
# BR2_PACKAGE_MESA3D_GALLIUM_DRIVER_PANFROST is not set
# meson_dri.so (Amlogic KMS/display 드라이버) 빌드를 위해 swrast 포함
BR2_PACKAGE_MESA3D_GALLIUM_DRIVER_SWRAST=y
BR2_PACKAGE_MESA3D_OPENGL_EGL=y
BR2_PACKAGE_MESA3D_OPENGL_ES=y

# Vulkan loader (빌드 타임 libvulkan.so 링킹용, 런타임 ICD는 mali.json → libMali.so)
BR2_PACKAGE_VULKAN_HEADERS=y
BR2_PACKAGE_VULKAN_LOADER=y

# SDL2 (RetroArch 의존성)
BR2_PACKAGE_SDL2=y
BR2_PACKAGE_SDL2_OPENGLES=y
BR2_PACKAGE_SDL2_KMSDRM=y

# 오디오
BR2_PACKAGE_ALSA_UTILS=y
BR2_PACKAGE_ALSA_UTILS_APLAY=y
BR2_PACKAGE_ALSA_UTILS_AMIXER=y

# EmulationStation 의존성
BR2_PACKAGE_VLC=y
BR2_PACKAGE_VLC_PULSE=n
BR2_PACKAGE_VLC_ALSA=y
BR2_PACKAGE_FREEIMAGE=y
BR2_PACKAGE_FREETYPE=y
BR2_PACKAGE_LIBCURL=y
BR2_PACKAGE_RAPIDJSON=y

# RetroArch v1.22.2 + libretro cores
BR2_PACKAGE_RETROARCH=y
BR2_PACKAGE_LIBRETRO_CORES=y

# EmulationStation
BR2_PACKAGE_EMULATIONSTATION=y
BR2_PACKAGE_BUNDLED_ROMS=y

# Kodi Media Center (GBM/GLES2, KMS/DRM)
BR2_PACKAGE_KODI_PANGUI=y
BR2_PACKAGE_XKEYBOARD_CONFIG=y

# mDNS (hostname.local 접속)
BR2_PACKAGE_DBUS=y
BR2_PACKAGE_AVAHI=y
BR2_PACKAGE_AVAHI_DAEMON=y
BR2_PACKAGE_NSS_MDNS=y

# Python3
BR2_PACKAGE_PYTHON3=y

# SMB 네트워크 파일 공유 (ksmbd: 커널 내장 SMB3 서버, Samba4보다 의존성 없음)
BR2_PACKAGE_KSMBD_TOOLS=y

# 시간 동기화 (NTP)
BR2_PACKAGE_OPENNTPD=y

# 유틸리티
BR2_PACKAGE_HTOP=y
BR2_PACKAGE_NANO=y
BR2_PACKAGE_VIM=y

# 압축 도구
BR2_PACKAGE_UNZIP=y
BR2_PACKAGE_ZIP=y
BR2_PACKAGE_P7ZIP=y

# SD 카드 이미지 생성
BR2_PACKAGE_HOST_DOSFSTOOLS=y
BR2_PACKAGE_HOST_GENIMAGE=y
BR2_PACKAGE_HOST_MTOOLS=y
BR2_PACKAGE_HOST_UBOOT_TOOLS=y

# 빌드 후 스크립트
BR2_ROOTFS_POST_BUILD_SCRIPT="board/odroidc5/post-build.sh"
BR2_ROOTFS_POST_IMAGE_SCRIPT="board/odroidc5/post-image.sh"
BR2_ROOTFS_POST_SCRIPT_ARGS="$(BR2_DEFCONFIG)"

# 오버레이
BR2_ROOTFS_OVERLAY="board/odroidc5/rootfs-overlay"
```
