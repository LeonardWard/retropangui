## configs/retropangui-odroidc5_defconfig
```kconfig
# Odroid C5 Retro Gaming OS Configuration
# Target: Amlogic S905X5M (ARM Cortex-A55)

# 다운로드 미러 — savannah.gnu.org 등 불안정한 서버 우회
BR2_PRIMARY_SITE="https://sources.buildroot.net"

# 타겟 아키텍처
BR2_aarch64=y
BR2_cortex_a55=y
# S905X5M (Cortex-A55 기반 S7D 계열)
BR2_ARM_FPU_NEON_FP_ARMV8=y

# 시스템 설정
BR2_SYSTEM_DHCP="eth0"
BR2_TARGET_GENERIC_HOSTNAME="retropangui-c5"
BR2_TARGET_GENERIC_ISSUE="RETROPANGUI-C5 Retro Gaming OS"
BR2_ROOTFS_DEVICE_CREATION_DYNAMIC_EUDEV=y

# 타임존 (zoneinfo 설치 + 기본값 Asia/Seoul)
BR2_TARGET_TZ_INFO=y
BR2_TARGET_LOCALTIME="Asia/Seoul"

# 툴체인
BR2_TOOLCHAIN_BUILDROOT_CXX=y
BR2_TOOLCHAIN_BUILDROOT_GLIBC=y
BR2_TOOLCHAIN_BUILDROOT_LOCALE=y
BR2_PACKAGE_GLIBC_UTILS=y
BR2_TOOLCHAIN_BUILDROOT_WCHAR=y
BR2_GENERATE_LOCALE="en_US.UTF-8 ko_KR.UTF-8"
# locale purge(기본 활성) 화이트리스트 — ko_KR 없으면 .mo와 로케일 데이터가 빌드 막바지에 삭제됨
BR2_ENABLE_LOCALE_WHITELIST="C en_US en_US.UTF-8 ko_KR ko_KR.UTF-8"
# gconv 문자 인코딩 변환 모듈(iconv용) — 예전엔 출처 미기록 ELF 3개
# (UNICODE/UTF-16/UTF-32.so)+gconv-modules를 rootfs-overlay에 직접 커밋해서
# 썼는데, buildroot 표준 옵션으로 전환(2026-07-13, 바이너리 전수 목록 후속).
# LIST는 .so 확장자 없는 모듈 이름 - buildroot가 gconv-modules 설정도
# 알아서 걸러 생성해줌.
BR2_TOOLCHAIN_GLIBC_GCONV_LIBS_COPY=y
BR2_TOOLCHAIN_GLIBC_GCONV_LIBS_LIST="UNICODE UTF-16 UTF-32"
BR2_KERNEL_HEADERS_5_15=y

# U-Boot (Hardkernel 공식 브랜치)
BR2_TARGET_UBOOT=y
BR2_TARGET_UBOOT_BUILD_SYSTEM_SIMPLE=y
BR2_TARGET_UBOOT_CUSTOM_GIT=y
BR2_TARGET_UBOOT_CUSTOM_REPO_URL="https://git.odroid.com/yocto/uboot"
BR2_TARGET_UBOOT_CUSTOM_REPO_VERSION="odroidc5-v2023.01"
BR2_TARGET_UBOOT_BOARD_DEFCONFIG="s7d_odroidc5"
BR2_TARGET_UBOOT_BOARDNAME="s7d_odroidc5"
BR2_TARGET_UBOOT_NEEDS_DTC=y
# BR2_TARGET_UBOOT_FORMAT_BIN is not set
BR2_TARGET_UBOOT_FORMAT_CUSTOM=y
BR2_TARGET_UBOOT_FORMAT_CUSTOM_NAME="build/u-boot.bin"

# Linux Kernel (Hardkernel 공식 브랜치 — git 전체 히스토리 불필요, tarball로 다운로드)
BR2_LINUX_KERNEL=y
BR2_LINUX_KERNEL_CUSTOM_TARBALL=y
BR2_LINUX_KERNEL_CUSTOM_TARBALL_LOCATION="https://github.com/hardkernel/linux/archive/refs/heads/odroids7d-5.15.y.tar.gz"
BR2_LINUX_KERNEL_DEFCONFIG="odroidc5"
BR2_LINUX_KERNEL_NEEDS_HOST_OPENSSL=y
BR2_LINUX_KERNEL_INSTALL_TARGET=y
BR2_LINUX_KERNEL_PATCH="board/odroidc5/patches/linux"
BR2_LINUX_KERNEL_CONFIG_FRAGMENT_FILES="board/odroidc5/linux-ksmbd.config"

# Device Tree
BR2_LINUX_KERNEL_DTS_SUPPORT=y
BR2_LINUX_KERNEL_INTREE_DTS_NAME="amlogic/s7d_s905x5m_odroidc5"

# 파일시스템 — squashfs (OTA 업데이트용, initramfs가 loop mount)
BR2_TARGET_ROOTFS_SQUASHFS=y
BR2_TARGET_ROOTFS_SQUASHFS4_ZSTD=y
# BR2_TARGET_ROOTFS_EXT2 is not set
# BR2_TARGET_ROOTFS_TAR is not set

# initramfs 패키지 (squashfs/overlayfs 마운트 + share 파티션 생성)
BR2_PACKAGE_RETROPANGUI_INITRAMFS=y

# 2026-07-08: 기본 busybox.config는 유니코드 지원이 꺼져있어서 ls 등에서 한글
# 등 ASCII 아닌 문자가 전부 "?"로 강제 치환되던 문제 수정(실제 파일명/내용은
# 항상 정상이었음, 화면 표시만 깨짐) - board/odroidc5/busybox-unicode.config 참고.
BR2_PACKAGE_BUSYBOX_CONFIG_FRAGMENT_FILES="board/odroidc5/busybox-unicode.config"

# 네트워크 패키지
BR2_PACKAGE_BUSYBOX_SHOW_OTHERS=y
BR2_PACKAGE_OPENSSH=y
BR2_PACKAGE_RSYNC=y
BR2_PACKAGE_SSHPASS=y
BR2_PACKAGE_CA_CERTIFICATES=y
BR2_PACKAGE_WGET=y
BR2_PACKAGE_WIRELESS_TOOLS=y

# WiFi (USB 동글, rpui-wifi 데몬이 제어)
BR2_PACKAGE_WPA_SUPPLICANT=y
BR2_PACKAGE_WPA_SUPPLICANT_NL80211=y
BR2_PACKAGE_WPA_SUPPLICANT_CLI=y

# 하드커널 WiFi Module 5BK(RTL8821CU) 커널 드라이버 — mainline rtw88엔 USB 버전이 없어서
# out-of-tree 드라이버 필요. Buildroot 기본 rtl8821cu 패키지(morrownr 소스)는 커널
# 5.15+ cfg80211 API 변경으로 빌드 실패해서, br2-external의 rpui-rtl8821cu(brektrou
# 소스)로 대체. (2026-07-03 실기기 테스트 중 발견 + 빌드 실패 확인 후 교체)
BR2_PACKAGE_RPUI_RTL8821CU=y

# 블루투스 펌웨어 (WiFi Module 5BK 콤보칩 RTL8821C 등) — btrtl 드라이버는 있으나
# rtl_bt/rtl8821c_fw.bin 펌웨어 파일이 없어 hci0 초기화 실패하던 문제 (2026-07-03 확인)
BR2_PACKAGE_LINUX_FIRMWARE=y
BR2_PACKAGE_LINUX_FIRMWARE_RTL_88XX_BT=y

# br2-external 패치 디렉토리 (SDL2 Mali Valhall 색상 수정, RetroArch DRM 수정 포함)
BR2_GLOBAL_PATCH_DIR="$(BR2_EXTERNAL_C5_PANGUI_PATH)/patches"

# Mali DDK (전용 바이너리 — board/odroidc5/fetch-blobs.sh 선행 실행 필요)
BR2_PACKAGE_MALI_DDK=y

# 그래픽 라이브러리
BR2_PACKAGE_LIBDRM=y
BR2_PACKAGE_LIBCAP=y
# Wayland (libMali.so 런타임 의존성 - Mali DDK 바이너리가 wayland-client/server를 직접 요구)
BR2_PACKAGE_WAYLAND=y

# exFAT (Share 파티션)
BR2_PACKAGE_EXFATPROGS=y
# Mesa3D - 빌드 타임 링킹용 (런타임은 libMali.so가 대체)
# Mali-G310 Valhall은 panfrost 미지원, libMali DDK 사용
BR2_PACKAGE_MESA3D=y
# panfrost는 Mali-G310 Valhall 미지원 → 크래시 원인, 제거
# BR2_PACKAGE_MESA3D_GALLIUM_DRIVER_PANFROST is not set
# meson_dri.so (Amlogic KMS/display 드라이버) 빌드를 위해 swrast 포함
BR2_PACKAGE_MESA3D_GALLIUM_DRIVER_SWRAST=y
BR2_PACKAGE_MESA3D_OPENGL_EGL=y
BR2_PACKAGE_MESA3D_OPENGL_ES=y

# Vulkan loader (빌드 타임 libvulkan.so 링킹용, 런타임 ICD는 mali.json → libMali.so)
BR2_PACKAGE_VULKAN_HEADERS=y
BR2_PACKAGE_VULKAN_LOADER=y

# SDL2 (RetroArch 의존성)
BR2_PACKAGE_SDL2=y
BR2_PACKAGE_SDL2_OPENGLES=y
BR2_PACKAGE_SDL2_KMSDRM=y

# 오디오
BR2_PACKAGE_ALSA_UTILS=y
BR2_PACKAGE_ALSA_UTILS_APLAY=y
BR2_PACKAGE_ALSA_UTILS_AMIXER=y
# 2026-07-11: 배경음악 MIDI를 외부 하드웨어 MIDI 신디사이저(예: MT-32
# 에뮬레이터)로 직접 보내는 기능(MusicManager.cpp)에 필요.
BR2_PACKAGE_ALSA_UTILS_APLAYMIDI=y

# 스플래시 비디오 플레이어
BR2_PACKAGE_FFMPEG_SWSCALE=y
BR2_PACKAGE_MPV=y

# EmulationStation 의존성
BR2_PACKAGE_VLC=y
BR2_PACKAGE_VLC_PULSE=n
BR2_PACKAGE_VLC_ALSA=y
# MIDI BGM: VLC fluidsynth 플러그인 + FluidR3_GM.sf2(MIT, fluid-soundfont)
# 주의: 기존 빌드에 추가할 때는 make vlc-dirclean 후 재빌드해야 플러그인이 생김
# 2026-07-14: archive.org발 MT32.sf2(라이선스 불명확)를 폐기하고 이걸로 교체
BR2_PACKAGE_FLUIDSYNTH=y
BR2_PACKAGE_FLUID_SOUNDFONT=y
BR2_PACKAGE_FREEIMAGE=y
BR2_PACKAGE_FREETYPE=y
BR2_PACKAGE_LIBCURL=y
BR2_PACKAGE_RAPIDJSON=y

# RetroArch v1.22.2 + libretro cores + UI assets
BR2_PACKAGE_RETROARCH=y
BR2_PACKAGE_RETROARCH_ASSETS=y
BR2_PACKAGE_RETROARCH_JOYPAD_AUTOCONFIG=y
# 2026-07-14: 코어별 독립 패키지로 분해(libretro-cores 단일 패키지 폐기)
BR2_PACKAGE_LIBRETRO_CORE_FCEUMM=y
BR2_PACKAGE_LIBRETRO_CORE_NESTOPIA=y
BR2_PACKAGE_LIBRETRO_CORE_SNES9X=y
BR2_PACKAGE_LIBRETRO_CORE_PCSX_REARMED=y
# 2026-07-16: 실기기 검증(Saru! Get You! 등) 결과 버퍼링으로 C5에서 실사용
# 무리 - 소스/패키지 정의는 유지, 빌드에서만 비활성화(todo-core-lr-beetle-psx-hw.html).
# 다른 타겟(GPU 여유 있는 임베디드/PC)에서는 다시 켤 수 있음.
# BR2_PACKAGE_LIBRETRO_CORE_BEETLE_PSX_HW=y
BR2_PACKAGE_LIBRETRO_CORE_PICODRIVE=y
BR2_PACKAGE_LIBRETRO_CORE_BLUEMSX=y
BR2_PACKAGE_LIBRETRO_CORE_DOSBOX_PURE=y
BR2_PACKAGE_LIBRETRO_CORE_SCUMMVM=y
BR2_PACKAGE_LIBRETRO_CORE_QUASI88=y
BR2_PACKAGE_LIBRETRO_CORE_NP2KAI=y
# 2026-07-16: Grandia 실측 - 인트로 특정 구간(1:30~2:30)에서 사운드 버벅임 +
# 약 0.7배속. RetroArch 자체 계측 평균 20~26Hz(목표 60Hz), 프레임타임 편차
# 17~23%(todo-core-lr-beetle-saturn.html). CPU는 16~34%만 써서 연산 병목
# 아님, video_driver(gl/vulkan)·cdimagecache 옵션 우회 둘 다 실패 - 소프트웨어
# 렌더러 코어 내부 문제로 추정되나 코어 패치 없인 원인 특정 불가, 코어 패치는
# 이 프로젝트가 하지 않으므로([[feedback_no_core_patching]]) 비활성화.
# 소스/패키지 정의는 유지. saturn은 이제 yabasanshiro만 남음(미검증).
# BR2_PACKAGE_LIBRETRO_CORE_BEETLE_SATURN=y
# 2026-07-16: 모든 CPU코어/RDP렌더러 조합에서 100% 크래시 확정
# (todo-core-lr-mupen64plus-next.html) - 원인은 상류 GLideN64 소스의
# glMapBufferRange() NULL 미체크 버그(Mali-G310 드라이버가 이 매핑에
# 실패), 코어 패치는 이 프로젝트가 하지 않으므로([[feedback_no_core_patching]])
# 비활성화. 소스/패키지 정의는 유지, n64는 parallel-n64가 1순위.
# BR2_PACKAGE_LIBRETRO_CORE_MUPEN64PLUS_NEXT=y
BR2_PACKAGE_LIBRETRO_CORE_PARALLEL_N64=y
BR2_PACKAGE_LIBRETRO_CORE_PPSSPP=y
# 2026-07-16: VDP2 블릿 셰이더가 GLSL ES 스펙 위반("Global variable
# initializer must be a constant expression")으로 Mali 컴파일러가 거부 →
# abort() 100% 재현 확정(todo-core-lr-kronos.html). 코어 패치는 이
# 프로젝트가 하지 않으므로([[feedback_no_core_patching]]) 비활성화.
# 소스/패키지 정의는 유지. saturn은 이제 yabasanshiro만 남음(미검증,
# beetle-saturn도 같은 날 성능 문제로 비활성화됨 - 위 참고).
# BR2_PACKAGE_LIBRETRO_CORE_KRONOS=y
BR2_PACKAGE_LIBRETRO_CORE_BEETLE_BSNES=y
BR2_PACKAGE_LIBRETRO_CORE_YABASANSHIRO=y
# 2026-07-16: PCE/SuperGrafx는 이 프로젝트에 시스템 자체가 아직 없음
# (롬 폴더·테마 온보딩 별도 필요) - 코어 패키지만 준비, 이번엔 비활성화.
# BR2_PACKAGE_LIBRETRO_CORE_BEETLE_PCE=y
# BR2_PACKAGE_LIBRETRO_CORE_BEETLE_SUPERGRAFX=y

# EmulationStation
BR2_PACKAGE_EMULATIONSTATION=y
BR2_PACKAGE_RPUI_LAUNCHER=y
# 한중일 한자 폴백 폰트 - Pretendard(기본 UI 폰트)엔 한자 글리프가 없어서
# 일본/중국 게임 제목이 깨지는 문제 대응 (es-core/src/resources/Font.cpp가
# 이미 이 경로를 폴백 후보로 참조하고 있었음)
BR2_PACKAGE_NOTO_CJK_FONT=y
BR2_PACKAGE_BUNDLED_FONTS=y
BR2_PACKAGE_BUNDLED_ROMS=y
BR2_PACKAGE_BUNDLED_BGMUSIC=y
BR2_PACKAGE_RPUI_BUNDLEGAME=y

BR2_PACKAGE_STORAGE_MGR=y
BR2_PACKAGE_ODROID_DRM_FBSET=y
BR2_PACKAGE_RPUI_WIFI=y
BR2_PACKAGE_RPUI_BT=y

# 2026-07-16: 원격 스트리밍(todo-20260709-remote-streaming.html) 빌드에서 제외.
# 소프트웨어 x264 경로는 실기기에서 크래시 확정(Sunshine의 GLAD 바인딩이 데스크탑
# GL 4.6으로 고정 생성돼 이 보드의 GLES 전용 Mali 드라이버와 함수 포인터 수준에서
# 안 맞음 - NULL 함수 포인터 호출로 SIGSEGV, LD_PRELOAD 트랩으로 확인).
# Vulkan 우회도 막힘(Mali-G310 드라이버에 VK_KHR_video_encode_queue 등 video 확장
# 자체가 없음, vulkaninfo 대체 프로그램으로 직접 확인). Amlogic 자체 하드웨어
# 인코더(amvenc_multi)도 커널 드라이버는 있으나 C5(S905X5M)용 devicetree에
# "cnm, MultiEnc" 노드 자체가 없음(T7/C2/C1 계열 SoC에만 있음) - 처음부터
# 새로 만들어야 하는 수준이라 이번 범위 밖. 이 프로젝트 본질(레트로 게이밍)과
# 거리가 있는 별도 컴포넌트라 여기서 접음 - 소스/패키지 정의는 유지, 나중에
# 재검토 가능.
# BR2_PACKAGE_SUNSHINE=y
# 아래는 Sunshine 링크 전용 의존성이라 같이 비활성화.
# BR2_PACKAGE_PULSEAUDIO=y
# BR2_PACKAGE_XORG7=y
# BR2_PACKAGE_LIBVA=y

# Kodi Media Center (GBM/GLES2, KMS/DRM)
BR2_PACKAGE_KODI_PANGUI=y
# BR2_PACKAGE_KODI_PERIPHERAL_JOYSTICK_PANGUI is not set
BR2_PACKAGE_XKEYBOARD_CONFIG=y

# mDNS (hostname.local 접속)
BR2_PACKAGE_DBUS=y
BR2_PACKAGE_AVAHI=y
BR2_PACKAGE_AVAHI_DAEMON=y

# Bluetooth (rpui-bt) — USB 동글, RTL8821CU 콤보칩 BT 펌웨어는 위 LINUX_FIRMWARE_RTL_88XX_BT로 이미 포함
BR2_PACKAGE_BLUEZ5_UTILS=y
BR2_PACKAGE_BLUEZ5_UTILS_CLIENT=y
BR2_PACKAGE_BLUEZ5_UTILS_PLUGINS_HID=y
BR2_PACKAGE_BLUEZ5_UTILS_PLUGINS_HOG=y
# sixaxis 플러그인 — BlueZ 5.12+부터 DS3 USB "MAC 각인" 페어링을 bluetoothd가
# 직접 처리(별도 sixpair 툴 불필요, udev 필요 - 이미 다른 곳에서 씀).
# 2026-07-10 밤, todo-20260705-ds3.html "MAC 각인 절차" 조사 결과로 추가.
BR2_PACKAGE_BLUEZ5_UTILS_PLUGINS_SIXAXIS=y
# 블루투스 오디오(A2DP) 재생 - bluez-alsa가 bluetoothd의 오디오 프로파일
# 플러그인(BLUEZ5_UTILS_PLUGINS_AUDIO)까지 자동으로 켜줌. alsa-plugins는
# 블루투스 기기별로 다른 샘플레이트를 변환해주는 samplerate 플러그인 때문에
# 필요(2026-07-11, todo-bluetooth-audio.html).
BR2_PACKAGE_BLUEZ_ALSA=y
BR2_PACKAGE_ALSA_PLUGINS=y
BR2_PACKAGE_NSS_MDNS=y

# Python3
BR2_PACKAGE_PYTHON3=y
# xml 모듈 — rpui-bundlegame.sh가 gamelist.xml 조작에 xml.etree.ElementTree 사용
# (2026-07-04: 빠져있어서 hide/show가 매번 ModuleNotFoundError로 조용히 실패하던 문제 확인)
BR2_PACKAGE_PYTHON3_PYEXPAT=y

# SMB 네트워크 파일 공유 (ksmbd: 커널 내장 SMB3 서버, Samba4보다 의존성 없음)
BR2_PACKAGE_KSMBD_TOOLS=y

# share 폴더 네트워크화(NAS 마운트, S61share sharedevice=NETWORK) - mount.cifs/mount.nfs
# 클라이언트 헬퍼. 서버 쪽(rpc.nfsd 등)은 불필요해서 명시적으로 끔.
BR2_PACKAGE_CIFS_UTILS=y
BR2_PACKAGE_NFS_UTILS=y
# BR2_PACKAGE_NFS_UTILS_RPC_NFSD is not set
# nfs-utils 2.6.4의 configure가 libmount(mount.pc)를 필수로 요구하는데
# buildroot 2024.02의 nfs-utils Config.in이 LIBBLKID만 select하고 LIBMOUNT를
# 빠뜨림(상류에서 나중에 수정된 종류의 버그). 클린 빌드에서만 드러남 -
# 로컬 캐시 빌드는 예전 설정의 mount.pc가 staging에 남아있어 우연히 통과했었음
# (WSL2 클린 빌드 2회 실측, 2026-07-12).
BR2_PACKAGE_UTIL_LINUX_LIBMOUNT=y

# 시간 동기화 (NTP)
BR2_PACKAGE_OPENNTPD=y

# 유틸리티
BR2_PACKAGE_HTOP=y
BR2_PACKAGE_NANO=y
BR2_PACKAGE_VIM=y
# setfont 제공 - 터미널 유틸리티 콘솔 폰트를 기본(8x16)보다 키우기 위함(2026-07-06)
BR2_PACKAGE_KBD=y
# 터미널 유틸리티 한글 입출력(2026-07-06, todo-20260706-terminal-cjk 참고):
# fbterm(freetype/fontconfig 기반 콘솔 - 한글 폰트로 화면에 그림) +
# uim(uim-fep+벼루 - 한글 자모 조합 입력, br2-external 커스텀 패키지)
# 2026-07-08: fbterm은 이 기기(DRM_FBDEV_EMULATION)와 화면 렌더링이
# 근본적으로 안 맞아서(실기기 확인 - 배너는 fbcon으로 나오는데 fbterm이
# 그래픽 모드로 전환하면 화면이 검게 나옴) kmscon(DRM 네이티브 콘솔,
# br2-external 커스텀 패키지)으로 교체. uim(한글 조합 로직)은 그대로 씀 -
# kmscon --login -- uim-fep 형태로 통합.
# BR2_PACKAGE_FBTERM=y  # kmscon으로 교체(2026-07-08)
BR2_PACKAGE_UIM=y
BR2_PACKAGE_KMSCON=y
BR2_PACKAGE_LIBXKBCOMMON=y

# Node.js/npm — AI CLI(Claude Code 등) 설치 지원 목적. Buildroot 자체 nodejs
# 패키지는 20.11.1로 고정돼 있어 Claude Code(node>=22.0.0 요구)가 설치조차
# 안 됨 — nodejs.org 공식 사전 컴파일 바이너리를 그대로 쓰는 자체 패키지로
# 대체(2026-07-05, br2-external/package/rpui-nodejs). 이미지엔 런타임만
# 포함, 실제 AI CLI는 rpui-wifi로 기기에서 직접 npm install -g로 설치.
BR2_PACKAGE_RPUI_NODEJS=y

# 압축 도구
BR2_PACKAGE_UNZIP=y
BR2_PACKAGE_ZIP=y
BR2_PACKAGE_P7ZIP=y

# SD 카드 이미지 생성
BR2_PACKAGE_HOST_DOSFSTOOLS=y
BR2_PACKAGE_HOST_E2FSPROGS=y
BR2_PACKAGE_HOST_GENIMAGE=y
BR2_PACKAGE_HOST_MTOOLS=y
BR2_PACKAGE_HOST_UBOOT_TOOLS=y

# 빌드 후 스크립트
BR2_ROOTFS_POST_BUILD_SCRIPT="board/odroidc5/post-build.sh"
BR2_ROOTFS_POST_IMAGE_SCRIPT="board/odroidc5/post-image.sh"
BR2_ROOTFS_POST_SCRIPT_ARGS="$(BR2_DEFCONFIG)"

# 오버레이
BR2_ROOTFS_OVERLAY="board/odroidc5/rootfs-overlay"
```
